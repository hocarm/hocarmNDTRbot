/* Chương trình đọc nhiệt độ, độ ẩm từ cảm biến DHT
  Thêm chức năng đọc cảm biến ánh sáng
  Thêm chức năng đọc cảm biến độ ẩm đất
  Thêm hiển thị LCD
  HocARM NDTR BOT by hocARM.org
  -------------------------------------------------
  Kết nối
  DHT       | TIVA C
  --------------------
  VCC(1)    |  3.3V
  DATA(2)   |  PD0
  NC(3)     |  x
  GND(4)    |  GND

  Kết nối chân 1 của DHT với 3.3V
  Chân 2 kết nối với bất kỳ chân nào của TIVA C
  Chân 4 nối với GND
  Nối trở 10k giữa chân 1 và chân 2
  ------------------------------------------
  So thu tu GLCD và kết nối với TIVA
  // Pin  |   Chuc nang       |   TIVA C
  //------------------------------------------
  // 1    |    GND            |   GND
  // 2    |    RST            |   PE1
  // 3    |    SCK            |   PD2
  // 4    |    A0(C/D)        |   PD3
  // 5    |    LED K+ (3.3V)  |   3.3V
  // 6    |    LED A (GND)    |   GND
  // 7    |    SDA            |   PD1
  // 8    |    CS             |   PE2
  // 9    |    VCC            |   3.3V
  // 10   |    GND            |   GND
*/
#include "DHT.h"
#include "homephone.h"

#define DHTPIN PD_0     // Chân DATA nối với PD0
#define LDR_PIN PE_3    // Chân PE3 nối với chân OUT cảm biến as
#define SOIL_MOIST_1_PIN PE_4 // Chân PE4 nối với cảm biến độ ẩm
// Relay, nút nhấn
#define PUMPW_ON PF_4   //Nút có sẵn trên kit
#define PUMPW_PIN PC_6
#define PUMPS_ON PF_0   //Nút có sẵn trên kit
#define PUMPS_PIN PC_7
// Uncomment loại cảm biến bạn sử dụng, nếu DHT11 thì uncomment DHT11 và comment DHT22
//#define DHTTYPE DHT11   // DHT 11
#define DHTTYPE DHT22   // DHT 22  (AM2302), AM2321
//#define DHTTYPE DHT21   // DHT 21 (AM2301)
const unsigned char ha_lg [] = {
  0x00, 0x00, 0x00, 0x00, 0x00, 0x00, 0x00, 0x00, 0x00, 0x00, 0x00, 0x00, 0x00, 0x00, 0x00, 0x00,
  0x00, 0x00, 0x00, 0x00, 0x00, 0x00, 0x00, 0x00, 0x00, 0x00, 0x00, 0x00, 0x00, 0x00, 0x00, 0x00,
  0x00, 0x00, 0x00, 0x00, 0x00, 0x00, 0x00, 0x00, 0x00, 0x00, 0x00, 0x00, 0x00, 0x00, 0x00, 0x00,
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  0x00, 0x00, 0x00, 0x00, 0x00, 0x00, 0x00, 0x00,
};
// Biến lưu các giá trị cảm biến
int humDHT;
int tempDHT;
int lumen;
int soilMoist;
// Biến lưu trạng thái bơm
boolean pumpWaterStatus = 0;
boolean pumpPesStatus = 0;
int timePumpOn = 10; // Thời gian bật bơm nước
// Biến cho timer
long sampleTimingSeconds = 50; // ==> Thời gian đọc cảm biến (s)
long startTiming = 0;
long elapsedTime = 0;
// Khởi tạo cảm biến
DHT dht(DHTPIN, DHTTYPE);
// Khởi tạo LCD
homephone lcd (PD_1, PD_2, PD_3, PE_1, PE_2);
void setup() {
  pinMode(PUMPW_PIN, OUTPUT);
  pinMode(PUMPS_PIN, OUTPUT);
  pinMode(PUMPW_ON, INPUT_PULLUP); 
  pinMode(PUMPS_ON, INPUT_PULLUP); 
  // Khởi tạo cổng serial baud 115200
  Serial.begin(115200);
  Serial.println("HocARM NDTR Bot!");
  // Bắt đầu đọc dữ liệu
  dht.begin();
  lcd.begin();            //Khởi tạo LCD
  lcd.setContrast(0x0A);  //Đặt độ tương phản
  lcd.clear();            //Xóa màn hình
  lcd.drawBitmap(0, 0, 127, 63, ha_lg, black); // Hiển thị hình bitmap
  lcd.display();
  readSensors(); // Khởi tạo đọc cảm biến
  startTiming = millis(); // Bắt đầu đếm thời gian
  lcd.clear();
}

void loop() {
  // Khởi tạo timer
  elapsedTime = millis() - startTiming;
  readLocalCmd();
  showDataLCD();
  if (elapsedTime > (sampleTimingSeconds * 1000))
  {
    readSensors();
    printData();
    startTiming = millis();
  }
}
int getLumen(int anaPin)
{
  int anaValue = 0;
  for (int i = 0; i < 10; i++) // Đọc giá trị cảm biến 10 lần và lấy giá trị trung bình
  {
    anaValue += analogRead(anaPin);
    delay(50);
  }

  anaValue = anaValue / 10;
  anaValue = map(anaValue, 4095, 0, 0, 100); //Tối:0  ==> Sáng 100%

  return anaValue;
}
int getSoilMoist()
{
  int i = 0;
  int anaValue = 0;
  for (i = 0; i < 10; i++)  //
  {
    anaValue += analogRead(SOIL_MOIST_1_PIN); //Đọc giá trị cảm biến độ ẩm đất
    delay(50);   // Đợi đọc giá trị ADC
  }
  anaValue = anaValue / (i);
  anaValue = map(anaValue, 4095, 0, 0, 100); //Ít nước:0%  ==> Nhiều nước 100%
  return anaValue;
}
void readSensors(void)
{
  tempDHT = dht.readTemperature();   //Đọc nhiệt độ DHT22
  humDHT = dht.readHumidity();       //Đọc độ ẩm DHT22
  lumen = getLumen(LDR_PIN);         //Đọc ánh sáng
  soilMoist = getSoilMoist();        //Đọc cảm biến độ ẩm đất
}
void showDataLCD(void)
{
  lcd.setTextColor(black, white);
  lcd.setCursor(0, 0);    //đặt con trỏ vào tọa độ (0,0)
  lcd.print("**-HOCARM NDTR Bot-**");
  lcd.setCursor (0, 10);
  lcd.print("---------------------");
  lcd.setCursor (0, 20);
  lcd.print("Nhdo: ");
  lcd.print(tempDHT);
  lcd.print("oC  Doam: ");
  lcd.print(humDHT);
  lcd.print("%  ");
  lcd.setCursor (0, 30);
  lcd.print("Asag: ");
  lcd.print(lumen);
  lcd.print("%");
  lcd.print("  Amdat: ");
  lcd.print(soilMoist);
  lcd.print("%");
  lcd.setCursor (0, 40);
  lcd.print("BomN: ");
  lcd.print(pumpWaterStatus);
  lcd.print("     BomS: ");
  lcd.print(pumpPesStatus);
  lcd.display();
  lcd.setCursor (0, 0);
  lcd.display();
}
void printData(void)
{
  // IN thông tin ra màn hình
  Serial.print("Do am: ");
  Serial.print(humDHT);
  Serial.print(" %\t");
  Serial.print("Nhiet do: ");
  Serial.print(tempDHT);
  Serial.print(" *C\t");
  Serial.print("Anh sang: ");
  Serial.print(lumen);
  Serial.print(" %\t");
  Serial.print("Do am dat: ");
  Serial.print(soilMoist);
  Serial.println(" %");
}
/***************************************************
  Hàm bật bơm nước
****************************************************/
void turnPumpOn()
{
  digitalWrite(PUMPW_PIN, LOW);
  pumpWaterStatus = 1;
  showDataLCD();
  delay (timePumpOn * 1000);
  digitalWrite(PUMPW_PIN, HIGH);
  pumpWaterStatus = 0;
  showDataLCD();
}
/****************************************************************
  Hàm đọc trạng thái bơm và kiểm tra nút nhấn
  (Nút nhấn mặc định là mức "CAO"):
****************************************************************/
void readLocalCmd()
{
  int digiValue = debounce(PUMPW_ON);
  if (!digiValue)
  {
    pumpWaterStatus = !pumpWaterStatus;
    showDataLCD();
    aplyCmd();
  }
  digiValue = debounce(PUMPS_ON);
  if (!digiValue)
  {
    pumpPesStatus = !pumpPesStatus;
    showDataLCD();
    aplyCmd();
  }
}
/***************************************************
  Thực hiện điều khiển các bơm
****************************************************/
void aplyCmd()
{
  if (pumpWaterStatus == 1) digitalWrite(PUMPW_PIN, LOW);
  if (pumpWaterStatus == 0) digitalWrite(PUMPW_PIN, HIGH);

  if (pumpPesStatus == 1) digitalWrite(PUMPS_PIN, LOW);
  if (pumpPesStatus == 0) digitalWrite(PUMPS_PIN, HIGH);
}
/***************************************************
  Hàm kiểm tra trạng thái phím bấm
****************************************************/
boolean debounce(int pin)
{
  boolean state;
  boolean previousState;
  const int debounceDelay = 60;

  previousState = digitalRead(pin);
  for (int counter = 0; counter < debounceDelay; counter++)
  {
    delay(1);
    state = digitalRead(pin);
    if (state != previousState)
    {
      counter = 0;
      previousState = state;
    }
  }
  return state;
}
